## boards/shields/corne_left_peripheral/Kconfig.defconfig
```kconfig
# Copyright (c) 2020 The ZMK Contributors
# SPDX-License-Identifier: MIT

if SHIELD_CORNE_LEFT_PERIPHERAL

config ZMK_KEYBOARD_NAME
	default "Corne Left"

config ZMK_SPLIT
	default y

endif
```

## boards/shields/corne_left_peripheral/Kconfig.shield
```kconfig
# Copyright (c) 2020 The ZMK Contributors
# SPDX-License-Identifier: MIT

config SHIELD_CORNE_LEFT_PERIPHERAL
	def_bool $(shields_list_contains,corne_left_peripheral)
```

## boards/shields/corne_right_peripheral/Kconfig.defconfig
```kconfig
# Copyright (c) 2020 The ZMK Contributors
# SPDX-License-Identifier: MIT

if SHIELD_CORNE_RIGHT_PERIPHERAL

config ZMK_KEYBOARD_NAME
	default "Corne Right"

config ZMK_SPLIT
	default y

endif
```

## boards/shields/corne_right_peripheral/Kconfig.shield
```kconfig
# Copyright (c) 2020 The ZMK Contributors
# SPDX-License-Identifier: MIT

config SHIELD_CORNE_RIGHT_PERIPHERAL
	def_bool $(shields_list_contains,corne_right_peripheral)
```
